## board/telechips/tcc897x_evb/Kconfig
```kconfig
if TCC8971_EVB

config SYS_BOARD
	default "tcc897x_evb"

config SYS_VENDOR
	default "telechips"

config SYS_CONFIG_NAME
	default "tcc8971-evb"

endif
```

## configs/tcc897x-lcn_defconfig
```kconfig
CONFIG_ARM=y
CONFIG_ARCH_TELECHIPS=y
CONFIG_TCC8971_LCN=y
CONFIG_FIT=y
CONFIG_SYS_PROMPT="TCC # "
CONFIG_CMD_USB=y
CONFIG_USB=y
CONFIG_USB_DWC2=y
CONFIG_USB_STORAGE=y
CONFIG_USB_FUNCTION_FASTBOOT=y
CONFIG_FBCON=y
CONFIG_USE_LCD_1920x720=y
```

## drivers/video/tcc/Kconfig
```kconfig
config LCD_AT070TN93
	bool "INNOLUX AT070TN93 LCD support"
	depends on ARCH_TELECHIPS

config LCD_ED090NA
	bool "ED090NA: CHIMEI INNOLUX 1280 * 800 LVDS support"
	depends on ARCH_TELECHIPS

config LCD_FLD0800
	bool "FLD0800: 1024 * 600 LVDS support"
	depends on ARCH_TELECHIPS
```

## u-boot/arch/arm/mach-tcc897x/Kconfig
```kconfig
if ARCH_TELECHIPS

config TCC897X
	bool
	default y

config SYS_SOC
	default "tcc897x"

config DAUDIO_KK
	bool
	default y

choice
	prompt "Telechips Board select"
	optional

config TCC8971_EVB
	bool "TCC8971 EVB Evaluation Board"

config TCC8971_LCN
	bool "TCC8971 LCN Evaluation Board"

endchoice


choice
    prompt "Boot Dev select"
    default TCC_BOOT_EMMC
    help
     Telechips EVM Select Boot device

config TCC_BOOT_EMMC
    bool "eMMC"
    select BOOT_EMMC

config TCC_BOOT_SNOR
    bool "Serial NOR flash"
    select BOOT_SNOR

config TCC_BOOT_NAND
    bool "NAND flash"
    select BOOT_NAND

endchoice


source "board/telechips/tcc897x_evb/Kconfig"
source "board/telechips/tcc897x_lcn/Kconfig"

endif
```

## u-boot/configs/tcc897x_defconfig
```kconfig
CONFIG_ARM=y
CONFIG_ARCH_TELECHIPS=y
CONFIG_TARGET_TCC897X=y
CONFIG_TCC_BOOT_EMMC=y
CONFIG_SYS_PROMPT="TCC # "
CONFIG_USB=y
CONFIG_USB_DWC2=y
CONFIG_DAUDIO_KK=y
```
